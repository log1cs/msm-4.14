## drivers/power/Kconfig
```kconfig
config QNS_SYSTEM
	bool "Qnovo QNS wrapper implementation"
	default n
	help
	  Say Y here to enable support for QNS system.
	  QNS is a battery charging controller and it necessary to access a
	  kernel driver for a battery charging.
	  This adds sysfs interface which enables QNS daemon to access it.

config WIRELESS_CHARGER_P9221
	bool "IDT P9221 Wireless Charging control Driver"
	depends on I2C
	help
	  IDT P9221 wireless charging control driver

source "drivers/power/avs/Kconfig"
source "drivers/power/reset/Kconfig"
source "drivers/power/supply/Kconfig"
```
