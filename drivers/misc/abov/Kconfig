## drivers/misc/abov/Kconfig
```kconfig
config SARSENSOR_ABOV
	tristate "Abov SAR sensor driver"
	depends on SENSORS_CLASS
	help
	  Say Y here if you want to enable Abov SAR sensor driver.
```

## drivers/misc/sx9325/Kconfig
```kconfig
config SARSENSOR_SX9325
	tristate "Semtech SX9325 SAR sensor driver"
	depends on SENSORS_CLASS
	help
	  Say Y here if you want to enable Semtech SX9325 SAR sensor driver.
```
